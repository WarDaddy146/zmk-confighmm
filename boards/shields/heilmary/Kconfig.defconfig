## boards/shields/heilmary/Kconfig.defconfig
```kconfig
if SHIELD_HEILMARY

config ZMK_KEYBOARD_NAME
    default "heilmary"

if ZMK_DISPLAY

choice ZMK_DISPLAY_STATUS_SCREEN
    default ZMK_DISPLAY_STATUS_SCREEN_CUSTOM
endchoice

config I2C
    default y

config SSD1306
    default y

endif # ZMK_DISPLAY

if LVGL

config LV_Z_VDB_SIZE
    default 64

config LV_Z_MEM_POOL_SIZE
    default 8192

config LV_DPI_DEF
    default 148

config LV_Z_BITS_PER_PIXEL
    default 1

choice LV_COLOR_DEPTH
    default LV_COLOR_DEPTH_1
endchoice

endif # LVGL

endif # SHIELD_HEILMARY
```
